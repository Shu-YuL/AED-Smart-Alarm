## Firmware/Monitoring_Device_CAM/main/Kconfig.projbuild
```kconfig
menu "Application Configuration"

    choice BOARD
        bool "Select Board"
        default BOARD_ESP32CAM_AITHINKER
        help
            Select Board Type.

        config BOARD_WROVER_KIT
            bool "Freenove ESP32-WROVER CAM Board"
        config BOARD_CAMERA_MODEL_ESP_EYE
            bool "Espressif ESP-EYE"
        config BOARD_ESP32CAM_AITHINKER
            bool "AiThinker ESP32-CAM"
        config BOARD_CAMERA_MODEL_TTGO_T_JOURNAL
            bool "TTGO T-Journal ESP32 Camera"
    endchoice

endmenu
```
